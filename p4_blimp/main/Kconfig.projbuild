## p4_blimp/main/Kconfig.projbuild
```kconfig
menu "Example Configuration"

    choice BLIMP_CAMERA_SENSOR
        prompt "Camera sensor"
        default BLIMP_CAMERA_IMX219
        help
            Select the MIPI-CSI camera fitted to this blimp. This is a
            compile-time choice; rebuild and flash after changing it.

        config BLIMP_CAMERA_IMX219
            bool "Sony IMX219 (local driver)"

        config BLIMP_CAMERA_OV5647
            bool "OmniVision OV5647 (Espressif driver)"
            select CAMERA_OV5647
            select CAMERA_OV5647_AUTO_DETECT_MIPI_INTERFACE_SENSOR
    endchoice

    config BLIMP_CAMERA_XCLK_GPIO
        int "Camera XCLK GPIO (-1 for module-provided clock)"
        range -1 54
        default 20 if BLIMP_CAMERA_IMX219
        default -1 if BLIMP_CAMERA_OV5647
        help
            IMX219 on the tested carrier needs 24 MHz on GPIO20. The tested
            OV5647 setup supplies its own clock and therefore uses -1.

    config BLIMP_CAMERA_ROTATE_180
        bool "Rotate camera image 180 degrees"
        default y
        help
            Rotate the streamed image by 180 degrees in the software demosaic
            step. Disable this when the camera is mounted upright. The default
            preserves the orientation used by earlier BlimpSoftware firmware.

    config ESP_WIFI_SSID
        string "WiFi SSID"
        default "myssid"
        help
            SSID (Network Name) for the example to connect to.

    config ESP_WIFI_PASSWORD
        string "WiFi Password"
        default "mypassword"
        help
            WiFi Password for the example to connect to.

    config BLIMP_COMMAND_PORT
        int "BlimpSoftware UDP command/telemetry port"
        default 5004

    config BLIMP_VIDEO_PORT
        int "BlimpSoftware UDP JPEG port"
        default 5005

    config BLIMP_LEFT_ESC_GPIO
        int "Left ESC GPIO"
        default 29

    config BLIMP_RIGHT_ESC_GPIO
        int "Right ESC GPIO"
        default 28

    config BLIMP_LEFT_TILT_GPIO
        int "Left tilt servo GPIO"
        default 5

    config BLIMP_RIGHT_TILT_GPIO
        int "Right tilt servo GPIO"
        default 4

    config BLIMP_LEFT_MOTOR_INVERTED
        bool "Reverse left motor output"
        default y

    config BLIMP_RIGHT_MOTOR_INVERTED
        bool "Reverse right motor output"
        default n

    config BLIMP_LEFT_ESC_NEUTRAL_US
        int "Left ESC neutral pulse (microseconds)"
        range 1400 1600
        default 1500
        help
            Pulse that completely stops the left ESC. This calibrated neutral
            is also used by E-stop and the command watchdog.

    config BLIMP_RIGHT_ESC_NEUTRAL_US
        int "Right ESC neutral pulse (microseconds)"
        range 1400 1600
        default 1500
        help
            Pulse that completely stops the right ESC. This calibrated neutral
            is also used by E-stop and the command watchdog.

    config BLIMP_LEFT_MOTOR_FORWARD_SCALE_PERCENT
        int "Left motor forward scale (percent)"
        range 0 100
        default 100
        help
            Scale logical forward commands for the left motor. This is applied
            before motor reversal, so forward always means blimp forward.

    config BLIMP_LEFT_MOTOR_REVERSE_SCALE_PERCENT
        int "Left motor reverse scale (percent)"
        range 0 100
        default 100
        help
            Scale logical reverse commands for the left motor. This is applied
            before motor reversal, so reverse always means blimp reverse.

    config BLIMP_RIGHT_MOTOR_FORWARD_SCALE_PERCENT
        int "Right motor forward scale (percent)"
        range 0 100
        default 100
        help
            Scale logical forward commands for the right motor. This is applied
            before motor reversal, so forward always means blimp forward.

    config BLIMP_RIGHT_MOTOR_REVERSE_SCALE_PERCENT
        int "Right motor reverse scale (percent)"
        range 0 100
        default 100
        help
            Scale logical reverse commands for the right motor. This is applied
            before motor reversal, so reverse always means blimp reverse.

    config BLIMP_STEERING_SENSITIVITY_PERCENT
        int "Steering sensitivity (percent)"
        range 0 100
        default 50
        help
            Scale only the differential steering contribution after receiving
            the mixed left/right motor commands. Straight-line throttle is not
            changed. 100 preserves the original response, 50 halves steering
            authority, and 0 disables steering.

    config BLIMP_THROTTLE_SLEW_PERCENT_PER_SEC
        int "Throttle ramp rate (percent of full throttle per second)"
        range 0 2000
        default 150
        help
            Limit how fast commanded thrust may change, easing the step inputs
            that pitch the nose up and down. 150 means a stick slammed from
            neutral to full takes about 0.7 s to get there; 300 takes about
            0.35 s; 0 disables ramping and restores the original instant
            response. Lower values are gentler but delay the response.

            Only the throttle component is ramped, so steering stays crisp.
            E-stop and the command-timeout failsafe still cut the motors
            immediately and are never slowed by this setting.

    config BLIMP_LEFT_SERVO_INVERTED
        bool "Reverse left tilt servo output"
        default y

    config BLIMP_RIGHT_SERVO_INVERTED
        bool "Reverse right tilt servo output"
        default n

    config BLIMP_LEFT_SERVO_NEUTRAL_ANGLE
        int "Left tilt servo neutral angle (degrees)"
        range 1 179
        default 90
        help
            Physical servo output angle used when the logical tilt command is
            neutral (90 degrees). Endpoints remain 0 and 180 degrees.

    config BLIMP_RIGHT_SERVO_NEUTRAL_ANGLE
        int "Right tilt servo neutral angle (degrees)"
        range 1 179
        default 90
        help
            Physical servo output angle used when the logical tilt command is
            neutral (90 degrees). Endpoints remain 0 and 180 degrees.

    config BLIMP_IMU_SCL_GPIO
        int "MPU6050 SCL GPIO"
        default 8

    config BLIMP_IMU_SDA_GPIO
        int "MPU6050 SDA GPIO"
        default 7

    config BLIMP_IMU_POWER_GPIO
        int "MPU6050 power-enable GPIO (-1 when powered from 3.3 V)"
        range -1 54
        default -1

    config BLIMP_IMU_ZERO_AT_STARTUP
        bool "Zero roll and pitch at startup"
        default y
        help
            Treat the attitude measured immediately after the stationary gyro
            calibration as level (zero roll and zero pitch). Keep the blimp in
            its desired reference attitude during startup.

    choice BLIMP_IMU_TILT_AXIS_MAPPING
        prompt "IMU left/right and up/down tilt-axis mapping"
        default BLIMP_IMU_AXES_SWAPPED
        help
            Select how the MPU6050 board's native roll and pitch axes map to
            the blimp attitude shown by the basestation.

        config BLIMP_IMU_AXES_NATIVE
            bool "Native: left/right = sensor roll, up/down = sensor pitch"

        config BLIMP_IMU_AXES_SWAPPED
            bool "Swapped: left/right = sensor pitch, up/down = sensor roll"
    endchoice

    config BLIMP_IMU_INVERT_ROLL
        bool "Invert displayed left/right tilt"
        default n

    config BLIMP_IMU_INVERT_PITCH
        bool "Invert displayed up/down tilt"
        default n

endmenu
```
